## linux-driver/buildroot_external/package/mem_module/Config.in
```kconfig
config BR2_PACKAGE_MEM_MODULE
        bool "mem_module"
        help
		Mem module
```

## linux-driver/buildroot_external/package/simics_shm/Config.in
```kconfig
config BR2_PACKAGE_SIMICS_SHM
        bool "simics_shm"
        help
		Simics shared memory module
```
